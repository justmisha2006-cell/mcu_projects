#include <WiFi.h>
#include <HTTPClient.h>
#include <WiFiClientSecure.h>
#include <ArduinoJson.h>
#include <Wire.h>
#include <U8g2lib.h>
#include <time.h>

// --- WIFI SETTINGS ---
const char* ssid = "DIR-842-a29f";
const char* password = "39673305";

// --- NTP SETTINGS (TIME SYNCHRONIZATION) ---
const char* ntpServer = "pool.ntp.org";
const char* time_zone = "EET-2EEST,M3.5.0/3,M10.5.0/4"; 

// --- SOUND ALERT REGION ---
const char* SOUND_REGION = "м. Київ"; 

// --- PIN DEFINITIONS ---
const int PIN_LED_KYIV     = 5;   // PWM via LEDC
const int PIN_LED_CHERKASY = 25;
const int PIN_LED_LUHANSK  = 32;
const int PIN_LED_ZHYTOMYR = 14;
const int PIN_LED_POLTAVA  = 15;
const int PIN_LED_CHERNIHIV= 18;
const int PIN_LED_ODESA    = 27;
const int PIN_LED_VINNYTSIA= 26;

const int PIN_LED_WIFI     = 16; 

const int PIN_TOUCH_TTP223 = 17;
const int PIN_BUZZER       = 13;

const int PIN_SDA          = 21;
const int PIN_SCL          = 22;

// PWM Settings for Kyiv LED
const int KYIV_PWM_FREQ    = 5000;
const int KYIV_PWM_RES     = 8; // 0..255

// --- OLED DISPLAY INITIALIZATION ---
U8G2_SH1106_128X64_NONAME_F_HW_I2C u8g2(U8G2_R2, /* reset=*/ U8X8_PIN_NONE, PIN_SCL, PIN_SDA);

const char* api_url = "https://ubilling.net.ua/aerialalerts/";

bool sound_region_alert_state = false;
bool first_check = true;

// Timers
unsigned long last_update = 0;
const unsigned long update_interval = 15000; // API check every 15s

unsigned long last_screen_toggle = 0;
const unsigned long SCREEN_TOGGLE_INTERVAL = 15000; // Auto screen switch every 5s
int current_auto_screen = 0; // 0: Main Clock, 1: System Info & Alerts Counter

// --- NOTIFICATION QUEUE STRUCTURE ---
struct Notification {
  const char* regionNameEn;
  bool isAlert; // true = ALERT STARTED, false = CLEAR
};

#define MAX_QUEUE_SIZE 16
Notification notifQueue[MAX_QUEUE_SIZE];
int queueHead = 0;
int queueTail = 0;
int queueCount = 0;

unsigned long notifStartTime = 0;
bool isShowingNotification = false;
const unsigned long NOTIF_DISPLAY_TIME = 5000; // Display notification for 5 seconds

void pushNotification(const char* nameEn, bool isAlert) {
  if (queueCount < MAX_QUEUE_SIZE) {
    notifQueue[queueTail].regionNameEn = nameEn;
    notifQueue[queueTail].isAlert = isAlert;
    queueTail = (queueTail + 1) % MAX_QUEUE_SIZE;
    queueCount++;
  }
}

bool popNotification(Notification &notif) {
  if (queueCount == 0) return false;
  notif = notifQueue[queueHead];
  queueHead = (queueHead + 1) % MAX_QUEUE_SIZE;
  queueCount--;
  return true;
}

// --- REGION DATA STRUCTURE ---
struct Region {
  const char* json_name;
  const char* name_en;
  int pin;
  bool current_alert;
  int map_x;
  int map_y;
};

Region regions[] = {
  {"м. Київ", "Kyiv City", PIN_LED_KYIV, false, 32, 12},
  {"Черкаська область", "Cherkasy Region", PIN_LED_CHERKASY, false, 33, 19},
  {"Луганська область", "Luhansk Region", PIN_LED_LUHANSK, false, 58, 17},
  {"Житомирська область", "Zhytomyr Region", PIN_LED_ZHYTOMYR, false, 23, 12},
  {"Полтавська область", "Poltava Region", PIN_LED_POLTAVA, false, 42, 16},
  {"Чернігівська область", "Chernihiv Region", PIN_LED_CHERNIHIV, false, 35, 7},
  {"Одеська область", "Odesa Region", PIN_LED_ODESA, false, 27, 28},
  {"Вінницька область", "Vinnytsia Region", PIN_LED_VINNYTSIA, false, 23, 21}
};

const int num_regions = sizeof(regions) / sizeof(regions[0]);
bool kyiv_region_alert = false;

// --- BITMAPS ---
static const unsigned char bitmap_ukraine_map[] PROGMEM = {
  0x00, 0x00, 0x00, 0xf8, 0x3f, 0x00, 0x00, 0x00, 0x00, 0x00, 0x00, 0xfc,
  0x7f, 0x80, 0x00, 0x00, 0x00, 0x00, 0x00, 0x1e, 0xf8, 0xe0, 0x00, 0x00,
  0x00, 0x00, 0x70, 0x0e, 0xe0, 0xf0, 0x01, 0x00, 0x00, 0x00, 0xf8, 0x07,
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  0x00, 0x00, 0x00, 0x00
};

static const unsigned char bitmap_good[] PROGMEM = {
  0x00, 0x42, 0x4C, 0x00, 0x00, 0xE6, 0x6E, 0x00, 0x00, 0xAE, 0x7B, 0x00, 0x00, 0x3A, 0x51, 0x00,
  0x00, 0x12, 0x40, 0x00, 0x00, 0x02, 0x40, 0x00, 0x00, 0x06, 0x40, 0x00, 0x00, 0x06, 0x40, 0x00,
  0x00, 0x04, 0x60, 0x00, 0x00, 0x0C, 0x20, 0x00, 0x00, 0x08, 0x30, 0x00, 0x00, 0x18, 0x18, 0x00,
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  0x00, 0xE0, 0x07, 0x00, 0x00, 0xC0, 0x03, 0x00
};

static const unsigned char bitmap_bad[] PROGMEM = {
  0x00, 0x80, 0x00, 0x00, 0x00, 0xC0, 0x00, 0x00, 0x00, 0xE0, 0x0D, 0x00, 0x00, 0xA0, 0x0F, 0x00,
  0x00, 0x20, 0x69, 0x00, 0x00, 0x10, 0x78, 0x02, 0x00, 0x10, 0xC0, 0x03, 0x00, 0x10, 0xC0, 0x03,
  0x00, 0x10, 0x00, 0x01, 0x00, 0x10, 0x80, 0x00, 0x00, 0x10, 0xC0, 0x00, 0x00, 0x30, 0x60, 0x00,
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  0x00, 0xF0, 0x03, 0x00, 0x00, 0xE0, 0x00, 0x00
};

static const unsigned char bitmap_logo[] PROGMEM = {
  0x00,0x00,0x00,0x00,0x00,0x00,0x00,0x00,0x00,0x00,0x00,0x00,0x00,0x00,0x00,0x00,
  0x00,0x00,0x0F,0x00,0x00,0x00,0x00,0x00,0x00,0x00,0x00,0x00,0x00,0x00,0x00,0x00,
  0x00,0xE0,0xFF,0x00,0x00,0x00,0x00,0x00,0x00,0x00,0x00,0x00,0x00,0x00,0x00,0x00,
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  0x00,0x00,0x00,0x00,0x00,0x00,0x00,0x00,0x00,0x00,0x00,0x00,0x00,0x00,0x00,0x00
};

// --- AUDIO FUNCTIONS ---
void playAlertSound() {
  int melody[] = {880, 0, 880, 0, 1174, 0, 880, 0, 1174};
  int duration[] = {150, 50, 150, 50, 300, 50, 150, 50, 400};
  for (int i = 0; i < 9; i++) {
    if (melody[i] == 0) noTone(PIN_BUZZER);
    else tone(PIN_BUZZER, melody[i], duration[i]);
    delay(duration[i] + 30);
  }
  noTone(PIN_BUZZER);
}

void playClearSound() {
  int melody[] = {1174, 0, 880, 0, 659};
  int duration[] = {200, 50, 200, 50, 500};
  for (int i = 0; i < 5; i++) {
    if (melody[i] == 0) noTone(PIN_BUZZER);
    else tone(PIN_BUZZER, melody[i], duration[i]);
    delay(duration[i] + 30);
  }
  noTone(PIN_BUZZER);
}

// --- SCREEN DRAWING FUNCTIONS ---

void draw_splash_screen(void) {
  u8g2.clearBuffer();
  u8g2.setFont(u8g2_font_ncenB08_tr);
  u8g2.drawStr(22, 58, "AIR ALERT MAP");
  u8g2.drawXBM(0, 5, 128, 32, bitmap_logo);
  u8g2.sendBuffer();
}

// SCREEN 1: Main Clock Screen
void drawMainClockScreen(void) {
  struct tm timeinfo;
  
  if (!getLocalTime(&timeinfo)) {
    u8g2.setFont(u8g2_font_7x14_tr);
    u8g2.drawStr(5, 20, "Syncing Time...");
  } else {
    u8g2.setFont(u8g2_font_7x14_tr);
    char dateStr[32];
    strftime(dateStr, sizeof(dateStr), "%Y-%m-%d %a", &timeinfo);
    u8g2.drawStr(5, 15, dateStr);

    char timeStr[16];
    strftime(timeStr, sizeof(timeStr), "%H:%M:%S", &timeinfo);
    u8g2.setFont(u8g2_font_9x15_tr);
    u8g2.drawStr(28, 38, timeStr);
  }
  
  u8g2.setFont(u8g2_font_ncenB08_tr);
  u8g2.drawStr(18, 58, "AIR ALERT MAP");
}

// SCREEN 2: Brand New System & Monitor Dashboard
void drawSystemDashboardScreen(void) {
  int activeAlertsCount = 0;
  for (int i = 0; i < num_regions; i++) {
    if (regions[i].current_alert) activeAlertsCount++;
  }

  u8g2.setFont(u8g2_font_6x10_tr);
  u8g2.drawStr(0, 10, "--- SYSTEM STATUS ---");

  // Wi-Fi Status
  u8g2.setFont(u8g2_font_5x7_tr);
  if (WiFi.status() == WL_CONNECTED) {
    u8g2.drawStr(0, 22, "WiFi: CONNECTED");
    char rssiStr[20];
    snprintf(rssiStr, sizeof(rssiStr), "Signal: %d dBm", WiFi.RSSI());
    u8g2.drawStr(0, 31, rssiStr);
  } else {
    u8g2.drawStr(0, 22, "WiFi: DISCONNECTED");
  }

  // Active Alerts Summary
  char alertSummary[30];
  snprintf(alertSummary, sizeof(alertSummary), "Active Alerts: %d / %d", activeAlertsCount, num_regions);
  u8g2.drawStr(0, 43, alertSummary);

  // Sound region state
  if (sound_region_alert_state) {
    u8g2.drawStr(0, 54, "Kyiv Sound: [ALERT!]");
  } else {
    u8g2.drawStr(0, 54, "Kyiv Sound: [SAFE]");
  }

  u8g2.drawHLine(0, 62, 128);
}

// POPUP NOTIFICATION SCREEN (Shows 5 seconds per event)
void drawNotificationScreen(const char* regionNameEn, bool isAlert) {
  u8g2.drawFrame(0, 0, 128, 64);
  u8g2.drawFrame(2, 2, 124, 60);

  u8g2.setFont(u8g2_font_7x14_tr);
  if (isAlert) {
    u8g2.drawStr(12, 18, "! AIR ALERT !");
  } else {
    u8g2.drawStr(18, 18, "ALL CLEAR");
  }

  u8g2.drawHLine(10, 23, 108);

  u8g2.setFont(u8g2_font_6x10_tr);
  int textWidth = u8g2.getStrWidth(regionNameEn);
  int startX = (128 - textWidth) / 2;
  if (startX < 4) startX = 4;
  u8g2.drawStr(startX, 38, regionNameEn);

  u8g2.setFont(u8g2_font_5x7_tr);
  if (isAlert) {
    u8g2.drawStr(18, 52, "TAKE SHELTER NOW!");
  } else {
    u8g2.drawStr(20, 52, "DANGER HAS PASSED");
  }
}

// TOUCH BUTTON SCREEN: 4-Region Icons
void drawAlertIcons(void) {
  for (int i = 0; i < 4; i++) {
    u8g2.drawXBM(i * 32, 0, 32, 30, regions[i].current_alert ? bitmap_bad : bitmap_good);
  }
  u8g2.setFont(u8g2_font_micro_tr);
  u8g2.drawStr(0, 42, regions[0].current_alert ? "Kyiv: ALERT" : "Kyiv: CLEAR");
  u8g2.drawStr(64, 42, regions[1].current_alert ? "Cherkasy: ALERT" : "Cherkasy: CLEAR");
  u8g2.drawStr(0, 54, regions[2].current_alert ? "Luhansk: ALERT" : "Luhansk: CLEAR");
  u8g2.drawStr(64, 54, regions[3].current_alert ? "Zhytomyr: ALERT" : "Zhytomyr: CLEAR");
}

// KYIV LED BRIGHTNESS CONTROL
void updateKyivLed() {
  int brightness = 0;

  if (regions[0].current_alert) {
    brightness = 255; // 100% brightness on Kyiv Alert
  } else if (kyiv_region_alert) {
    brightness = 75;  // 30% brightness on Region Alert
  } else {
    brightness = 0;   // Off
  }

  #if ESP_ARDUINO_VERSION >= ESP_ARDUINO_VERSION_VAL(3, 0, 0)
    ledcWrite(PIN_LED_KYIV, brightness);
  #else
    ledcWrite(0, brightness);
  #endif
}

void setup() {
  Serial.begin(115200);

  // 1. Enable WiFi Blue LED
  pinMode(PIN_LED_WIFI, OUTPUT);
  digitalWrite(PIN_LED_WIFI, HIGH); 

  // 2. Initialize Kyiv PWM
  #if ESP_ARDUINO_VERSION >= ESP_ARDUINO_VERSION_VAL(3, 0, 0)
    ledcAttach(PIN_LED_KYIV, KYIV_PWM_FREQ, KYIV_PWM_RES);
  #else
    ledcSetup(0, KYIV_PWM_FREQ, KYIV_PWM_RES);
    ledcAttachPin(PIN_LED_KYIV, 0);
  #endif

  // 3. Setup Region Pins
  for (int i = 1; i < num_regions; i++) {
    pinMode(regions[i].pin, OUTPUT);
    digitalWrite(regions[i].pin, LOW);
  }

  // 4. Peripherals Setup
  pinMode(PIN_TOUCH_TTP223, INPUT_PULLDOWN);
  pinMode(PIN_BUZZER, OUTPUT);

  u8g2.begin();

  draw_splash_screen();
  delay(2000);

  // 5. WiFi & NTP Connect
  WiFi.begin(ssid, password);
  while (WiFi.status() != WL_CONNECTED) {
    delay(250);
  }

  configTzTime(time_zone, ntpServer);
}

void checkAlerts() {
  if (WiFi.status() != WL_CONNECTED) return;

  WiFiClientSecure client;
  client.setInsecure();

  HTTPClient http;
  if (http.begin(client, api_url)) {
    int httpCode = http.GET();
    if (httpCode == HTTP_CODE_OK) {
      String payload = http.getString();
      
      DynamicJsonDocument doc(12288); 
      DeserializationError error = deserializeJson(doc, payload);

      if (!error) {
        JsonObject states = doc["states"];

        kyiv_region_alert = states["Київська область"]["alertnow"] | false;
        bool current_sound_region_alert = false;

        for (int i = 0; i < num_regions; i++) {
          bool newAlertState = states[regions[i].json_name]["alertnow"] | false;

          // Check if state changed -> add notification to queue
          if (!first_check && newAlertState != regions[i].current_alert) {
            pushNotification(regions[i].name_en, newAlertState);
          }

          regions[i].current_alert = newAlertState;

          if (strcmp(regions[i].json_name, "м. Київ") != 0) {
            digitalWrite(regions[i].pin, newAlertState ? HIGH : LOW);
          }

          if (strcmp(regions[i].json_name, SOUND_REGION) == 0) {
            current_sound_region_alert = regions[i].current_alert;
          }
        }

        // Buzzer Logic on tracked region status change
        if (!first_check) {
          if (current_sound_region_alert != sound_region_alert_state) {
            if (current_sound_region_alert) {
              playAlertSound();
            } else {
              playClearSound();
            }
          }
        }
        sound_region_alert_state = current_sound_region_alert;

        updateKyivLed();
        first_check = false;
      }
    }
    http.end();
  }
}

static Notification currentActiveNotif;

void loop() {
  // API Fetch Every 15s
  if (millis() - last_update >= update_interval || last_update == 0) {
    last_update = millis();
    checkAlerts();
  }

  // Automatic screen switch every 5 seconds (when no notification active)
  if (millis() - last_screen_toggle >= SCREEN_TOGGLE_INTERVAL) {
    last_screen_toggle = millis();
    current_auto_screen = (current_auto_screen + 1) % 2;
  }

  // Check Pop-Up Notification Queue
  if (!isShowingNotification && queueCount > 0) {
    if (popNotification(currentActiveNotif)) {
      isShowingNotification = true;
      notifStartTime = millis();
    }
  }

  if (isShowingNotification) {
    if (millis() - notifStartTime >= NOTIF_DISPLAY_TIME) {
      isShowingNotification = false; // 5 seconds expired
    }
  }

  // Read Touch Sensor
  int button_state = digitalRead(PIN_TOUCH_TTP223);

  u8g2.clearBuffer();
  
  if (button_state == HIGH) {
    // Touch button overrides all screens
    drawAlertIcons();
  } else if (isShowingNotification) {
    // Priority Pop-up for Alert / Clear Event (5s)
    drawNotificationScreen(currentActiveNotif.regionNameEn, currentActiveNotif.isAlert);
  } else {
    // Default screens toggle
    if (current_auto_screen == 0) {
      drawMainClockScreen();
    } else {
      drawSystemDashboardScreen();
    }
  }

  u8g2.sendBuffer();
  delay(20);
}